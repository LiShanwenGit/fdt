//uart1 device node

#include "demo.dtsi"

uart1: 
    compatible: "stm32f10x-uart"
    reg: 0x40013800
    interrupt: 53
    console:
        compatible: "stm32f10x-console"
        baudrate: 115200
    shell:
        compatible: "stm32f10x-shell"
        baudrate: 115200

//uart2 device node
uart2: 
    compatible: "stm32f10x-uart"
    reg: 0x40013800
    interrupt: 53

//spi1 device node
spi1:
    compatible: "stm32f10x-spi"
    reg: 0x40052000
    interrupt: 58
    gpios: <54 55 56 57 78> //cs mosi miso clk

    st7789v:
        compatible: "st,st7789v"
        width: 240
        height: 320
        backlight-gpios: 18
        reset-gpios: 19
        power-gpios: 20
        dc-gpios: 21

gpio-spi:
    compatible: "stm32f10x-gpio-spi"
    reg: 0x40010800
    clk-gpios: 14
    mosi-gpios: 15
    miso-gpios: 16
    cs-gpios: 17

gpio-spi3:
    compatible: "stm32f10x-gpio-spi"
    reg: 0x40010800
    clk-gpios: 14
    mosi-gpios: 15
    miso-gpios: 16
    cs-gpios: 17

&spi1:
    nodere:
        compatible: "st,st7789v"
    defe:
        defef: 587

&st7789v:
    status: "okay"

testnode:
    status: "enable"
    pwm: 25

&led:
    pwm: 50